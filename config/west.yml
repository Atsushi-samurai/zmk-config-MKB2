## config/west.yml
```yaml
manifest:
  remotes:
    - name: zmkfirmware
      url-base: https://github.com/zmkfirmware
    - name: caksoylar
      url-base: https://github.com/caksoylar
    - name: badjeff
      url-base: https://github.com/badjeff
    - name: te9no
      url-base: https://github.com/te9no
    - name: kot149
      url-base: https://github.com/kot149
    - name: mctechnology17
      url-base: https://github.com/mctechnology17
    - name: petejohanson
      url-base: https://github.com/petejohanson
    - name: cormoran
      url-base: https://github.com/cormoran
    - name: taichan1113
      url-base: https://github.com/taichan1113
  projects:
    - name: zmk
      # remote: zmkfirmware
      remote: te9no
      revision: v0.3-branch+dya
      import: app/west.yml
    - name: zmk-rgbled-widget
      remote: caksoylar
      revision: v0.3-branch
    - name: zmk-pmw3610-driver
      remote: badjeff
      revision: zmk-0.3
    - name: zmk-analog-input-driver
      remote: badjeff
      revision: main
    - name: zmk-nice-oled
      remote: te9no
      revision: main
    - name: zmk-layout-shift
      remote: kot149
      revision: v1
    - name: zmk-input-processor-keybind
      remote: te9no
      revision: main
    - name: cirque-input-module
      remote: petejohanson
      revision: main
    - name: zmk-driver-MLX90393
      remote: te9no
      revision: main
    - name: zmk-input-processor-report-rate-limit
      remote: badjeff
      revision: f43f37aae7aaa7bf0ec4d432683b873a7e3a8efa
    - name: zmk-driver-pat9125
      remote: taichan1113
      revision: f5c1937a93e534ed55ed40fb8d8d2ea075692858

    - name: zmk-module-runtime-input-processor
      remote: cormoran
      revision: dbf92f764de8b6ffd60bf5850514302875fe2570
    - name: zmk-module-battery-history
      remote: cormoran
      revision: main
    - name: zmk-module-ble-management
      remote: cormoran
      revision: 851661cd21f2aded8ec649da86e01a207dc4b973
    - name: zmk-module-settings-rpc
      remote: cormoran
      revision: main

  self:
    path: config
```
